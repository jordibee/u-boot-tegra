## arch/arm/mach-tegra/tegra194/Kconfig
```kconfig
if TEGRA194

choice
	prompt "Tegra194 board select"

config TARGET_P2972_0000
	bool "NVIDIA Tegra194 P2972-0000 board"
	help
	  This is the board of Jetson AGX Xavier Developer Kit.

endchoice

config SYS_SOC
	default "tegra194"

config SYS_INIT_SP_BSS_OFFSET
	default 524288

source "board/nvidia/p2972-0000/Kconfig"

endif
```

## board/nvidia/p2972-0000/Kconfig
```kconfig
if TARGET_P2972_0000

config SYS_BOARD
	default "p2972-0000"

config SYS_VENDOR
	default "nvidia"

config SYS_CONFIG_NAME
	default "p2972-0000"

endif
```

## configs/p2972-0000_defconfig
```kconfig
CONFIG_ARM=y
CONFIG_TEGRA=y
CONFIG_TEGRA194=y
CONFIG_TARGET_P2972_0000=y
CONFIG_DEFAULT_DEVICE_TREE="tegra194-p2972-0000"
CONFIG_OF_SYSTEM_SETUP=y
CONFIG_HUSH_PARSER=y
CONFIG_SYS_PROMPT="Tegra194 (P2972-0000) # "
# CONFIG_CMD_IMI is not set
# CONFIG_CMD_IMLS is not set
# CONFIG_CMD_FLASH is not set
CONFIG_CMD_MMC=y
CONFIG_CMD_SF=y
CONFIG_CMD_SPI=y
CONFIG_CMD_I2C=y
CONFIG_CMD_USB=y
# CONFIG_CMD_FPGA is not set
CONFIG_CMD_GPIO=y
# CONFIG_CMD_SETEXPR is not set
CONFIG_CMD_DHCP=y
# CONFIG_CMD_NFS is not set
CONFIG_CMD_MII=y
CONFIG_CMD_PING=y
CONFIG_CMD_EXT2=y
CONFIG_CMD_EXT4=y
CONFIG_CMD_EXT4_WRITE=y
CONFIG_CMD_FAT=y
CONFIG_CMD_FS_GENERIC=y
CONFIG_DWC_ETH_QOS=y
CONFIG_RTL8169=y
CONFIG_E1000=y
# CONFIG_PCI_TEGRA is not set
CONFIG_TEGRA194_BPMP_I2C=y
CONFIG_SYS_NS16550=y
CONFIG_USB=y
CONFIG_DM_USB=y
CONFIG_POWER_DOMAIN=y
CONFIG_TEGRA194_POWER_DOMAIN=y
CONFIG_POSITION_INDEPENDENT=y
```

## drivers/clk/tegra/Kconfig
```kconfig
config TEGRA186_CLOCK
	bool "Enable Tegra186 BPMP-based clock driver"
	depends on TEGRA186_BPMP
	help
	  Enable support for manipulating Tegra's on-SoC clocks via IPC
	  requests to the BPMP (Boot and Power Management Processor).

config TEGRA194_CLOCK
	bool "Enable Tegra194 BPMP-based clock driver"
	depends on TEGRA194_BPMP
	help
	  Enable support for manipulating Tegra's on-SoC clocks via IPC
	  requests to the BPMP (Boot and Power Management Processor).
```
